/**********************************************************************	 
* 公司名称 : 东莞市上古时代电子技术有限公司
* 模块名称 ：软件模拟I2C驱动 (100KHz)
* 系统主频 : 22.1184 MHz
* 创建人   : eysmcu
* 修改人   : eysmcu 
* 创建日期 : 2025年5月4日
* 店铺地址 : http://mindesigner.taobao.com
* 淘宝ID号 : eysmcu
* 重要声明 ：本例程为东莞市上古时代电子技术有限公司原创，本程序只供学习
使用，未经作者许可，不得用于其它任何用途，转载清注明出处！！！


						 Copyright(C) 上古时代
***********************************************************************/

#include "ANT_I2C.h"

/*****************************参数定义*********************************/
//1.I2C缓存数组

uint8_t I2C_Buffer[I2C_Buf_Length] = {0x00}; 	

/**********************************************************************
* 名称 : i2c_delay(void)
* 功能 : I2C专用延时
* 输入 : 无
* 输出 ：无
* 说明 : 无
***********************************************************************/
void i2c_delay(void)		//3us@22.1184MHz
{
	unsigned char data i;

	_nop_();
	_nop_();
	i = 13;
	while (--i);
}

/**********************************************************************
* 名称 : ANT_I2C_Initl(void)
* 功能 : I2C端口初始化
* 输入 : 无
* 输出 ：无
* 说明 : 无
***********************************************************************/
void ANT_I2C_Initl(void)
{
	I2C_SCL = 1;
	I2C_SDA = 1;
}
/**********************************************************************
* 名称 : I2C_Start(void)
* 功能 : I2C起始信号
* 输入 : 无
* 输出 ：无
* 说明 : 无
***********************************************************************/
void I2C_Start(void)
{
	I2C_SDA = 1;	  	  
	I2C_SCL = 1;		i2c_delay();
 	I2C_SDA = 0;		i2c_delay();	
	I2C_SCL = 0;
}
/**********************************************************************
* 名称 : I2C_Stop(void)
* 功能 : I2C停止信号
* 输入 : 无
* 输出 ：无
* 说明 : 无
***********************************************************************/
void I2C_Stop(void)
{
	I2C_SDA = 0;
	I2C_SCL = 1;		i2c_delay();
	I2C_SDA = 1; 		i2c_delay();								   	
}    
/**********************************************************************
* 名称 : I2C_Send_N_Ack(I2C_nACK n_Ack)
* 功能 : IIC发送应答/非应答信号函数
* 输入 : n_Ack -- 应答/非应答信号 
* 输出 ：无
* 说明 : 无
***********************************************************************/
void I2C_Send_N_Ack(I2C_nACK Ack)
{
	I2C_SDA = Ack;                  
	I2C_SCL = 1;		i2c_delay();                    
	I2C_SCL = 0;		i2c_delay();  
}
/**********************************************************************
* 名称 : I2C_Wait_Ack(void)
* 功能 : I2C等待应答信号函数
* 输入 : 无
* 输出 ：无
* 说明 : 无
***********************************************************************/
bit I2C_Wait_Ack(void)
{
	I2C_SCL = 1;		i2c_delay();                    	
	CY = I2C_SDA;                   	
	I2C_SCL = 0;		i2c_delay();                    	

	return(CY);	
}
/**********************************************************************
* 名称 : I2C_Send_Byte(uint8_t value)
* 功能 : I2C发送单字节数据函数
* 输入 : value -- 数据
* 输出 ：无
* 说明 : 无
***********************************************************************/
void I2C_Send_Byte(uint8_t value)
{
	uint8_t i;

	for(i = 0;i < 8;i ++)         
	{
		value <<= 1;              
		I2C_SDA = CY;               
		I2C_SCL = 1;	i2c_delay();                         
		I2C_SCL = 0;	i2c_delay();                
	}		
}
/**********************************************************************
* 名称 : I2C_Read_Byte(void)
* 功能 : I2C单字节读函数
* 输入 : 无
* 输出 ：value -- 数据
* 说明 : 无
***********************************************************************/
uint8_t I2C_Read_Byte(void)
{
	uint8_t i = 0,value = 0;

	I2C_SDA = 1;
	for(i = 0;i < 8;i ++)
	{
		value <<= 1;
		I2C_SCL = 1;	i2c_delay(); 		
		value |= I2C_SDA;
		I2C_SCL = 0;	i2c_delay(); 
	}
	return value;
}
/**********************************************************************
* 名称 : ANT_I2C_Wtite_nByte(uint8_t Device_Addr,uint8_t *buf,uint16_t Length)
* 功能 : I2C向指定设备写n个字节函数
* 输入 : Device_Addr -- 设备地址(从机地址)
		 *buf -- 数据
		 Length -- 写入长度
* 输出 ：无
* 说明 : 无
***********************************************************************/
void ANT_I2C_Wtite_nByte(uint8_t Device_Addr,uint8_t *buf,uint16_t Length)
{
	uint16_t i = 0;

	I2C_Start();            //起始信号
	I2C_Send_Byte(Device_Addr | I2C_WRITE);		//发送设备地址+写信号	
	I2C_Wait_Ack();
	delay_10us();			//延迟10us
	for(i = 0;i < Length;i ++)
	{
		I2C_Send_Byte(*buf ++); 				//写入数据
		I2C_Wait_Ack();	 
		delay_10us();		//延迟10us
	}
	I2C_Stop();           	//停止信号
	delay_15us();			//延迟15us
}
/**********************************************************************
* 名称 : ANT_I2C_Read_nByte(uint8_t Device_Addr,uint8_t *buf,uint16_t Length)
* 功能 : I2C从指定设备读n个字节函数
* 输入 : Device_Addr -- 设备地址(从机地址)
		 *buf -- 数据
		 Length -- 写入长度
* 输出 ：buf中的数据！！！
* 说明 : 无
***********************************************************************/
void ANT_I2C_Read_nByte(uint8_t Device_Addr,uint8_t *buf,uint16_t Length)
{
	uint16_t i = 0;

	I2C_Start();      		//起始信号
	I2C_Send_Byte(Device_Addr | I2C_READ);		//发送设备地址+读信号
	I2C_Wait_Ack();
	delay_10us();			//延迟10us
	for(i = 0;i < Length;i ++)
	{
		*buf ++ = I2C_Read_Byte(); 				//接收数据
		
		if (i == (Length - 1))
			I2C_Send_N_Ack(I2C_NAK); 			//非应答信号	
		else I2C_Send_N_Ack(I2C_ACK);			//应答信号

		delay_10us();		//延迟10us
	}
	I2C_Stop();          	//停止信号
	delay_15us();			//延迟15us	
}











