## Kconfig
```kconfig
source "$ZEPHYR_BASE/Kconfig"

menu "NRF52840_BLE Framework"


config DT_HAS_PPG
	bool
	default n

config DT_HAS_IMU
	bool
	default n

config DT_HAS_FLASH
	bool
	default n

config DT_HAS_GPS
	bool
	default n

config DT_HAS_BLE
	bool
	default n

config DT_HAS_MIC
	bool
	default n

config DT_HAS_SPK
	bool
	default n

config DT_HAS_PM
	bool
	default n


config HAL_AUDIO
	bool "Enable HAL Audio"
	default y
	help
	  Enable HAL audio abstraction layer.

config DRIVER_AUDIO_NRF
	bool "Enable nRF52840 Audio Driver"
	default y
	depends on HAL_AUDIO
	help
	  Enable nRF52840 audio driver implementation.

config PLATFORM_REGISTRY
	bool "Enable platform registry"
	default y
	help
	  Enable platform registry and selection mechanism.

config PLATFORM_NRF52840
	bool "Enable nRF52840 platform"
	default y
	depends on PLATFORM_REGISTRY
	help
	  Enable nRF52840 platform registration and init.


config HAL_PPG
	bool "Enable HAL PPG"
	default n
	default y if DT_HAS_PPG
	help
	  Enable HAL for PPG sensor.

config DRIVER_PPG_NRF
	bool "Enable nRF52840 PPG Driver"
	default n
	default y if DT_HAS_PPG
	depends on HAL_PPG
	help
	  Enable nRF52840 PPG driver implementation.

config PPG_SPI_PROBE
	bool "Enable GH3026 SPI probe at boot"
	default n
	depends on HAL_PPG
	depends on DRIVER_PPG_NRF
	help
	  Run a minimal GH3026 SPI link probe during boot by calling hal_ppg_init().

config PPG_GH_VERBOSE_LOG
	bool "Enable GH3026 library verbose log"
	default n
	depends on HAL_PPG
	depends on DRIVER_PPG_NRF
	help
	  Enable high-frequency logs inside Goodix GH3X2X demo library
	  (for example usGotEvent/FIFO event prints). Keep disabled during
	  normal PPG debugging to reduce RTT load and scheduling jitter.

config PPG_TUNE_MODE
	bool "Enable PPG tuning log mode"
	default n
	depends on HAL_PPG
	depends on DRIVER_PPG_NRF
	help
	  Focus runtime logs on PPG tuning. When enabled, high-rate periodic
	  logs from other services are suppressed and app_ppg_hr prints raw
	  per-sample values from hal_ppg_read().

config HAL_IMU
	bool "Enable HAL IMU"
	default n
	default y if DT_HAS_IMU
	help
	  Enable HAL for IMU sensor.

config DRIVER_IMU_NRF
	bool "Enable nRF52840 IMU Driver"
	default n
	default y if DT_HAS_IMU
	depends on HAL_IMU
	help
	  Enable nRF52840 IMU driver implementation.

config HAL_FLASH
	bool "Enable HAL Flash"
	default n
	default y if DT_HAS_FLASH
	help
	  Enable HAL for external flash.

config DRIVER_FLASH_NRF
	bool "Enable nRF52840 Flash Driver"
	default n
	default y if DT_HAS_FLASH
	depends on HAL_FLASH
	help
	  Enable nRF52840 external flash driver implementation.

config HAL_GPS
	bool "Enable HAL GPS"
	default n
	default y if DT_HAS_GPS
	help
	  Enable HAL for GPS.

config DRIVER_GPS_NRF
	bool "Enable nRF52840 GPS Driver"
	default n
	default y if DT_HAS_GPS
	depends on HAL_GPS
	help
	  Enable nRF52840 GPS driver implementation.

config HAL_BLE
	bool "Enable HAL BLE"
	default n
	default y if DT_HAS_BLE
	help
	  Enable HAL for BLE.

config DRIVER_BLE_NRF
	bool "Enable nRF52840 BLE Driver"
	default n
	default y if DT_HAS_BLE
	depends on HAL_BLE
	depends on BT
	depends on BT_PERIPHERAL
	help
	  Enable nRF52840 BLE driver implementation.

config HAL_MIC
	bool "Enable HAL Microphone"
	default n
	default y if DT_HAS_MIC
	help
	  Enable HAL for microphone input.

config DRIVER_MIC_NRF
	bool "Enable nRF52840 Mic Driver"
	default n
	default y if DT_HAS_MIC
	depends on HAL_MIC
	help
	  Enable nRF52840 microphone driver implementation.

config HAL_SPK
	bool "Enable HAL Speaker"
	default n
	default y if DT_HAS_SPK
	help
	  Enable HAL for speaker output.

config DRIVER_SPK_NRF
	bool "Enable nRF52840 Speaker Driver"
	default n
	default y if DT_HAS_SPK
	depends on HAL_SPK
	help
	  Enable nRF52840 speaker driver implementation.

config HAL_PM
	bool "Enable HAL Power Management"
	default n
	default y if DT_HAS_PM
	help
	  Enable HAL for power management.

config DRIVER_PM_NRF
	bool "Enable nRF52840 PM Driver"
	default n
	default y if DT_HAS_PM
	depends on HAL_PM
	help
	  Enable nRF52840 power management driver implementation.


config BLE_TEST
	bool "Enable BLE test thread"
	default n
	depends on HAL_BLE
	depends on DRIVER_BLE_NRF
	help
	  Enable temporary BLE test thread for driver validation.

config BLE_FORCE_SECURITY
	bool "Force BLE pairing (L2)"
	default n
	depends on HAL_BLE
	depends on DRIVER_BLE_NRF
	help
	  Request BLE security level L2 after connection (pairing/bonding).

config MIC_TEST
	bool "Enable MIC test thread"
	default n
	depends on HAL_MIC
	depends on DRIVER_MIC_NRF
	help
	  Enable temporary MIC test thread for driver validation.

config SPK_TEST
	bool "Enable speaker test thread"
	default n
	depends on HAL_SPK
	depends on DRIVER_SPK_NRF
	help
	  Enable temporary speaker test thread for driver validation.

config SPK_BOOT_TONE
	bool "Enable speaker boot tone"
	default n
	depends on HAL_SPK
	depends on DRIVER_SPK_NRF
	help
	  Play a short boot tone on startup for speaker validation.

config SPK_STREAM
	bool "Enable speaker BLE downlink stream"
	default n
	depends on HAL_SPK
	depends on DRIVER_SPK_NRF
	depends on HAL_BLE
	depends on DRIVER_BLE_NRF
	help
	  Enable BLE downlink audio stream to speaker playback.

config MIC_LEVEL_TEST
	bool "Enable mic level test (RMS/peak log)"
	default n
	depends on HAL_MIC
	depends on DRIVER_MIC_NRF
	help
	  Log microphone level (RMS/peak) locally without BLE.

config MIC_LEVEL_STEREO_TEST
	bool "Enable stereo mic level diagnosis"
	default n
	depends on MIC_LEVEL_TEST
	depends on HAL_MIC
	depends on DRIVER_MIC_NRF
	help
	  Capture both PDM half-cycles during MIC_LEVEL_TEST and print
	  separate left/right statistics. Leave disabled for normal single-mic
	  bring-up.

config MIC_PDM_CLK_POL
	bool "Invert PDM clock polarity"
	default n
	depends on HAL_MIC
	depends on DRIVER_MIC_NRF
	help
	  Set the PDM clock polarity field in the nRF DMIC driver.
	  Useful for debugging microphones that appear to respond but with
	  abnormally low amplitude.

config MIC_PDM_DATA_POL
	bool "Invert PDM data polarity"
	default n
	depends on HAL_MIC
	depends on DRIVER_MIC_NRF
	help
	  Set the PDM data polarity field in the nRF DMIC driver.
	  Useful for debugging microphones that appear to respond but with
	  abnormally low amplitude.

config MIC_PDM_CLK_SKEW
	int "PDM clock skew setting"
	range 0 255
	default 0
	depends on HAL_MIC
	depends on DRIVER_MIC_NRF
	help
	  Set the PDM clock skew field in the nRF DMIC driver. Leave at 0 for
	  the default timing, or change it during microphone bring-up to test
	  whether sampling edge alignment affects captured amplitude.

config MIC_PDM_USE_RIGHT
	bool "Use right PDM channel for mono mic path"
	default n
	depends on HAL_MIC
	depends on DRIVER_MIC_NRF
	help
	  In normal mono microphone mode, capture the right PDM half-cycle
	  instead of the default left channel. This is useful when the board's
	  active microphone is strapped to the right channel.

config APP_RTC_ENABLE
	bool "Enable realtime conversation service (app_rtc)"
	default y
	help
	  Enable app_rtc init and start in main application.

config BOOT_TONE
	bool "Enable boot tone"
	default y
	depends on HAL_SPK
	depends on DRIVER_SPK_NRF
	help
	  Play a short boot tone once at startup.

config IMU_TEST
	bool "Enable IMU test thread"
	default n
	depends on HAL_IMU
	depends on DRIVER_IMU_NRF
	help
	  Enable IMU test thread for driver validation.

config PM_TEST
	bool "Enable PMIC test thread"
	default n
	depends on HAL_PM
	depends on DRIVER_PM_NRF
	help
	  Enable PMIC test thread for driver validation.

config GPS_TEST
	bool "Enable GPS test thread"
	default n
	depends on HAL_GPS
	depends on DRIVER_GPS_NRF
	help
	  Enable GPS application thread for LC76G UART validation.

config PM_SERVICE
	bool "Enable PMIC service thread"
	default y
	depends on HAL_PM
	depends on DRIVER_PM_NRF
	help
	  Enable background PMIC service for battery/charger monitoring.

config PM_SERVICE_INTERVAL_MS
	int "PMIC service interval (ms)"
	default 1000
	depends on PM_SERVICE
	help
	  Sampling interval for PMIC service updates.

config PM_SERVICE_DEBUG_LOG
	bool "Enable PMIC service debug log"
	default n
	depends on PM_SERVICE
	help
	  Periodic battery log from PM service.


endmenu
```

## dts/bindings/power/maxim,max77658.yaml
```yaml
description: Maxim MAX77658 PMIC

compatible: "maxim,max77658"

include:
  - name: i2c-device.yaml

properties:
  nirq-gpios:
    type: phandle-array
    required: false
    description: nIRQ interrupt pin (active low, open-drain)
  alrt-gpios:
    type: phandle-array
    required: false
    description: ALRT alert pin (active low, open-drain)
```

## dts/bindings/sensor/ti,tmp119-sw-i2c.yaml
```yaml
description: TI TMP119 temperature sensor driven over software I2C GPIOs

compatible: "ti,tmp119-sw-i2c"

include: base.yaml

properties:
  reg:
    required: true
    description: 7-bit I2C address selected by the module jumper.

  scl-gpios:
    type: phandle-array
    required: true
    description: GPIO used as software-I2C SCL.

  sda-gpios:
    type: phandle-array
    required: true
    description: GPIO used as software-I2C SDA.

  alert-gpios:
    type: phandle-array
    required: true
    description: ALERT or data-ready GPIO from TMP119.
```
