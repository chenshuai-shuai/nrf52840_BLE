## CMakeLists.txt
```
# SPDX-License-Identifier: Apache-2.0

cmake_minimum_required(VERSION 3.20.0)

find_package(Zephyr REQUIRED HINTS $ENV{ZEPHYR_BASE})
project(gh3x2x_demo_based_on_nsc)

FILE(GLOB app_sources 
  src/*.c 
  src/service/*.c 
  src/gh3x2x_lib_v4100/*.c
  src/gh3x2x_lib_v4100/demo_kernel_code/src/*.c
  src/gh3x2x_lib_v4100/algo_params/*.c
  src/gh3x2x_lib_v4100/demo_algo_code/goodix_algo_call/src/*.c
  src/gh3x2x_lib_v4100/demo_algo_code/goodix_algo_application/src/*.c
  )
target_link_directories(
    app PRIVATE
    
  )
target_sources(app PRIVATE ${app_sources})

include_directories(
  src/gh3x2x_lib_v4100/demo_algo_code/goodix_algo_application/inc
  src/gh3x2x_lib_v4100/demo_algo_code/goodix_algo_call/inc
  src/gh3x2x_lib_v4100/algo_params
  src/gh3x2x_lib_v4100/demo_kernel_code/inc
  src/gh3x2x_lib_v4100/drv_lib
  src/service
)

zephyr_library_include_directories(
  ${ZEPHYR_BASE}/samples/bluetooth
  )

target_link_libraries(app PRIVATE
  -L../src/gh3x2x_lib_v4100/drv_lib/gcc_M4_softfp/_build/gcc_softfp
  -L../src/gh3x2x_lib_v4100/algo_lib/M4_gcc_softfp

  -Wl,--start-group

  libgh3x2x_drv_cortexM4l_band_gcc_softfp_agc.a
  libgh3x2x_drv_cortexM4l_band_gcc_softfp_ecg.a
  libgh3x2x_drv_cortexM4l_band_gcc_softfp_kernel.a
  libgh3x2x_drv_cortexM4l_band_gcc_softfp_zip.a
  
  libcortexM4_eabi-gcc_softfp_bt.a
  libcortexM4_eabi-gcc_softfp_ecg.a
  libcortexM4_eabi-gcc_softfp_hr.a
  libcortexM4_eabi-gcc_softfp_hrv.a
  libcortexM4_eabi-gcc_softfp_nadt.a
  libcortexM4_eabi-gcc_softfp_spo2.a
  libcortexM4_eabi-gcc_softfp_common.a

  libm.a
  libc.a
  libnosys.a
  libgcc.a

  -Wl,--end-group

)
```

## prj.conf
```kconfig
CONFIG_BT=y
CONFIG_BT_DEBUG_LOG=y
CONFIG_BT_SMP=y
CONFIG_BT_PERIPHERAL=y
CONFIG_BT_DIS=y
CONFIG_BT_DIS_PNP=n
CONFIG_BT_BAS=y
CONFIG_BT_HRS=y
CONFIG_BT_DEVICE_NAME="Zephyr Heartrate Sensor"
CONFIG_BT_DEVICE_APPEARANCE=833

CONFIG_SPI=y
CONFIG_DMA=y
CONFIG_SPI_ASYNC=y
CONFIG_PWM=y

CONFIG_LED=y
CONFIG_LED_PWM=y

CONFIG_LED_GPIO=y
CONFIG_DEBUG_THREAD_INFO=y
CONFIG_DEBUG_OPTIMIZATIONS=y
CONFIG_LED_STRIP=y
CONFIG_GPIO_DW=n
CONFIG_GPIO_DW_0=n
CONFIG_CAF=n
CONFIG_CAF_LEDS=n
CONFIG_CAF_LEDS_GPIO=n

CONFIG_FPU=y
# CONFIG_FLOAT=y
CONFIG_FP_SOFTABI=y
```

## nrf52840dk_nrf52840.overlay
```dts
// &pinctrl {
// 	spi0_default: spi0_default {
// 		group1 {
// 			psels = <NRF_PSEL(SPIM_SCK, 0, 27)>,
// 				<NRF_PSEL(SPIM_MOSI, 0, 26)>,
// 				<NRF_PSEL(SPIM_MISO, 0, 28)>;
// 		};
// 	};

// 	spi0_sleep: spi0_sleep {
// 		group1 {
// 			psels = <NRF_PSEL(SPIM_SCK, 0, 27)>,
// 				<NRF_PSEL(SPIM_MOSI, 0, 26)>,
// 				<NRF_PSEL(SPIM_MISO, 0, 28)>;
// 			low-power-enable;
// 		};
// 	};
// };

&spi0 {
	// compatible = "nordic,nrf-spi";
	/* Cannot be used together with i2c0. */
	status = "okay";
	// pinctrl-0 = <&spi0_default>;
	// pinctrl-1 = <&spi0_sleep>;
	// pinctrl-names = "default", "sleep";
};
```

## src/main.c
```c
/* main.c - Application main entry point */

/*
 * Copyright (c) 2015-2016 Intel Corporation
 *
 * SPDX-License-Identifier: Apache-2.0
 */

#include <zephyr/types.h>
#include <stddef.h>
#include <string.h>
#include <errno.h>
#include <sys/printk.h>
#include <sys/byteorder.h>
#include <zephyr.h>
#include <math.h>

#include <bluetooth/bluetooth.h>
#include <bluetooth/hci.h>
#include <bluetooth/conn.h>
#include <bluetooth/uuid.h>
#include <bluetooth/gatt.h>
#include <bluetooth/services/bas.h>
#include <bluetooth/services/hrs.h>

#include <zephyr/logging/log.h>

LOG_MODULE_REGISTER(main);

static const struct bt_data ad[] = {
	BT_DATA_BYTES(BT_DATA_FLAGS, (BT_LE_AD_GENERAL | BT_LE_AD_NO_BREDR)),
	BT_DATA_BYTES(BT_DATA_UUID16_ALL,
		      BT_UUID_16_ENCODE(BT_UUID_HRS_VAL),
		      BT_UUID_16_ENCODE(BT_UUID_BAS_VAL),
		      BT_UUID_16_ENCODE(BT_UUID_DIS_VAL))
};

static void connected(struct bt_conn *conn, uint8_t err)
{
	if (err) {
		printk("Connection failed (err 0x%02x)\n", err);
	} else {
		printk("Connected\n");
	}
}

static void disconnected(struct bt_conn *conn, uint8_t reason)
{
	printk("Disconnected (reason 0x%02x)\n", reason);
}

BT_CONN_CB_DEFINE(conn_callbacks) = {
	.connected = connected,
	.disconnected = disconnected,
};

static void bt_ready(void)
{
	int err;

	printk("Bluetooth initialized\n");

	err = bt_le_adv_start(BT_LE_ADV_CONN_NAME, ad, ARRAY_SIZE(ad), NULL, 0);
	if (err) {
		printk("Advertising failed to start (err %d)\n", err);
		return;
	}

	printk("Advertising successfully started\n");
}

static void auth_cancel(struct bt_conn *conn)
{
	char addr[BT_ADDR_LE_STR_LEN];

	bt_addr_le_to_str(bt_conn_get_dst(conn), addr, sizeof(addr));

	printk("Pairing cancelled: %s\n", addr);
}

static struct bt_conn_auth_cb auth_cb_display = {
	.cancel = auth_cancel,
};

static void bas_notify(void)
{
	uint8_t battery_level = bt_bas_get_battery_level();

	battery_level--;

	if (!battery_level) {
		battery_level = 100U;
	}

	bt_bas_set_battery_level(battery_level);
}

static void hrs_notify(void)
{
	static uint8_t heartrate = 90U;

	/* Heartrate measurements simulation */
	heartrate++;
	if (heartrate == 160U) {
		heartrate = 90U;
	}

	bt_hrs_notify(heartrate);
}

#include "gh3x2x_demo_config.h"
#include "gh3x2x_demo.h"
#include "ghealth.h"

void bt_ghealth_on_received(struct bt_conn *conn,
			 const uint8_t *const data, uint16_t len)
{
#if (__SUPPORT_PROTOCOL_ANALYZE__)
	Gh3x2xDemoProtocolProcess(data, len);
#endif
}

extern GU8 g_uchGh3x2xIntCallBackIsCalled;

static int init_ghealth(void)
{
	static struct bt_ghealth_cb ghealth_cb = {
		.received = bt_ghealth_on_received
	};

	int err = bt_ghealth_init(&ghealth_cb);

	if (err) {
		LOG_ERR("Cannot initialize NUS (err %d)", err);
	}

	return err;
}

void main(void)
{
	int err;

	err = bt_enable(NULL);
	if (err) {
		printk("Bluetooth init failed (err %d)\n", err);
		return;
	}
	init_ghealth();
	bt_ready();

	bt_conn_auth_cb_register(&auth_cb_display);

	/* Implement notification. At the moment there is no suitable way
	 * of starting delayed work so we do it here
	 */
	extern const k_tid_t gh3x2x_tid;
	k_thread_start(gh3x2x_tid);
	// Gh3x2xDemoInit();
    // expf(19);
    // Gh3x2xDemoStartSampling(GH3X2X_FUNCTION_HR);
	while (1) {
		k_msleep(10);
		// if(1 == g_uchGh3x2xIntCallBackIsCalled)
        // {
        //     Gh3x2xDemoInterruptProcess();
        // }
		/* Heartrate measurements simulation */
		// hrs_notify();

		/* Battery level simulation */
		// bas_notify();
	}
}
```
